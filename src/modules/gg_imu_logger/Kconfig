## src/modules/gg_imu_logger/Kconfig
```kconfig
menuconfig MODULES_GG_IMU_LOGGER
	bool "gg_imu_logger"
	default n
	---help---
		Enable support for GG IMU Logger module

		This module subscribes to vehicle_imu topics and logs the data
		to a separate ulog file on the SD card.
```

## src/systemcmds/gpio_line_test/Kconfig
```kconfig
menuconfig SYSTEMCMDS_GPIO_LINE_TEST
	bool "gpio_line_test"
	default n
	---help---
		Cycle the MicoAir H743 external IMU SPI and chip-select pins as GPIO outputs.
```
